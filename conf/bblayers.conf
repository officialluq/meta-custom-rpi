## conf/bblayers.conf
```bitbake
BBLAYERS ?= " \
  /workdir/yocto/sources/meta \
  /workdir/yocto/sources/meta-poky \
  /workdir/yocto/sources/meta-yocto-bsp \
  /workdir/yocto/sources/meta-raspberrypi \
  /workdir/yocto/sources/meta-qt5 \
  /workdir/yocto/sources/meta-custom \ 
  "
```

## conf/layer.conf
```bitbake
BBPATH .= ":${LAYERDIR}"

BBFILES += "${LAYERDIR}/recipes-*/*/*.bb \
            ${LAYERDIR}/recipes-*/*/*.bbappend \
            ${LAYERDIR}/recipes-*/*/*/*.bb \
            ${LAYERDIR}/recipes-*/*/*/*.bbappend"

BBFILE_COLLECTIONS += "td"
BBFILE_PATTERN_td := "^${LAYERDIR}/"
BBFILE_PRIORITY_td = "9"

LAYERSERIES_COMPAT_td = "hardknott kirkstone"
```
